## apps/firmware/sdkconfig.defaults
```kconfig
CONFIG_SPIRAM=y
CONFIG_ESP_CONSOLE_UART=y
CONFIG_ESP_CONSOLE_UART_NUM=0
CONFIG_ESP_CONSOLE_UART_BAUDRATE=115200
CONFIG_ESP_SYSTEM_EVENT_QUEUE_SIZE=32
CONFIG_ESP_WIFI_STATIC_RX_NUM=10
CONFIG_ESP_WIFI_DYNAMIC_RX_NUM=32
CONFIG_ESP_WIFI_AMPDU_TX_ENABLED=y
CONFIG_ESP_WIFI_AMPDU_RX_ENABLED=y
CONFIG_ESP_WIFI_NVS_ENABLED=y
CONFIG_ESP_WIFI_SOFTAP_BEACON_MAX_LEN=752
CONFIG_ESP_WIFI_MGMT_SBUF_NUM=32
CONFIG_ESP_WIFI_TX_BA_WIN=6
CONFIG_ESP_WIFI_RX_BA_WIN=6
CONFIG_ESP_WIFI_SCAN_METHOD=all_channel
CONFIG_ESP_WIFI_SCAN_AUTH_MODE_THRESHOLD=open
CONFIG_ESP_WIFI_SNR_MAX=40
CONFIG_ESP_WIFI_SNR_MIN=10
CONFIG_ESP_WIFI_SAMPLING_MODE=1
CONFIG_ESP_WIFI_DEFAULT_PS_MODE=wifi_ps_none
CONFIG_ESP_WIFI_STA_DISCONNECTED_PM_ENABLE=y
CONFIG_ESP_WIFI_SLP_BEACON_LOST_TIMEOUT=5
CONFIG_ESP_WIFI_SLP_DTIM_OFFSET=0
CONFIG_ESP_WIFI_SLP_BEACON_INTERVAL=100
CONFIG_ESP_WIFI_NETIF_ENABLED=y
CONFIG_ESP_WIFI_COEXIST_ENABLED=y
CONFIG_ESP_WIFI_NPA_ENABLED=y
CONFIG_ESP_WIFI_ENABLED=y
CONFIG_ESP_WIFI_AMPDU_TX_ENABLED=y
CONFIG_ESP_WIFI_AMPDU_RX_ENABLED=y

# Security
CONFIG_SECURE_BOOT_V2_ENABLED=n
CONFIG_SECURE_SIGNED_APPS_SCHEME=y
CONFIG_SECURE_SIGNED_APPS_SCHEME_RSA=y
CONFIG_SECURE_BOOT_SIGNING_KEY_RSA=y
CONFIG_SECURE_FLASH_ENCRYPTION_ENABLED=n

# NVS encryption
CONFIG_NVS_ENCRYPTION=y

# FreeRTOS
CONFIG_FREERTOS_HZ=100
CONFIG_FREERTOS_IDLE_TASK_STACKSIZE=2048
CONFIG_FREERTOS_TIMER_TASK_STACKSIZE=2048
CONFIG_FREERTOS_MAX_TASK_NAME_LEN=32

# Log level
CONFIG_LOG_DEFAULT_LEVEL_INFO=y
CONFIG_LOG_DEFAULT_LEVEL=3
```
